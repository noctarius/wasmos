## Kconfig
```kconfig
mainmenu "WASMOS Configuration"

menu "Build Options"

choice
    prompt "Target architecture"
    default WASMOS_ARCH_X86_64
    help
      The CPU architecture the kernel, the boot loader and the native ring-3
      modules are built for, and the QEMU machine the run targets boot.
      Everything that differs per architecture outside the sources lives in
      ARCHES in scripts/buildgen/toolchains.py.

config WASMOS_ARCH_X86_64
    bool "x86_64 (QEMU pc, OVMF)"

config WASMOS_ARCH_AARCH64
    bool "aarch64 (QEMU virt, edk2)"
    help
      arm64 port under wasm3, booting to the CLI and gated by
      run-qemu-test and the QEMU batteries, on one core or (WASMOS_SMP)
      several brought up through PSCI CPU_ON. WARP builds for aarch64 but
      does not run yet: its ring-3 entry and linear-memory window are
      x86_64-only. The interrupt controller choice (PIC/LAPIC/IOAPIC) is
      x86_64's.

endchoice

choice
    prompt "Real-time clock (aarch64)"
    default WASMOS_RTC_PL031
    depends on WASMOS_ARCH_AARCH64
    help
      Where the "rtc" service on aarch64 reads and sets the time. x86_64
      always uses the CMOS clock. Both choices serve the same protocol, so
      `date` and every other client work with either.

config WASMOS_RTC_PL031
    bool "PL031 driver (QEMU virt)"
    help
      The pl031 driver programs the Arm PL031 directly. QEMU virt's ACPI
      tables do not describe it, so acpi-bus publishes it from a board
      table keyed on the tables' OEM ID: it works on QEMU virt only.

config WASMOS_RTC_EFI
    bool "UEFI runtime services (GetTime/SetTime)"
    help
      The rtc_efi driver asks the firmware, through the UEFI GetTime and
      SetTime runtime services, which work on any UEFI board. The boot
      loader calls SetVirtualAddressMap before entering the kernel, mapping
      the firmware's runtime regions at their kernel direct-map addresses;
      the call cannot be undone, so it is made only with this choice. The
      driver starts at boot and is not restarted if it ends.

endchoice

menu "Examples"

config AS_ENABLE
    bool "Enable AssemblyScript example builds"
    default y

config RUST_ENABLE
    bool "Enable Rust example builds"
    default y

config GO_ENABLE
    bool "Enable Go (TinyGo) example builds"
    default y

config ZIG_ENABLE
    bool "Enable Zig example builds"
    default y

endmenu

config WASMOS_TRACE
    bool "Enable verbose kernel and userland tracing"
    default n

config WASMOS_RING3_SMOKE
    bool "Enable ring3 smoke probe spawn by default"
    default n

config WASMOS_RING3_THREAD_LIFECYCLE_SMOKE
    bool "Enable dedicated ring3 thread lifecycle helper probe spawn by default"
    default n

config WASMOS_PM_TEST_HOOKS
    bool "Enable process-manager test inject hooks"
    default n

choice
    prompt "Process-manager list backend"
    default WASMOS_PM_LIST_LINKED

config WASMOS_PM_LIST_LINKED
    bool "Linked list"

config WASMOS_PM_LIST_ARRAY_CHUNK
    bool "Array-chunk list (growable)"

endchoice

choice
    prompt "IRQ controller mode"
    default WASMOS_IRQ_IOAPIC
    depends on WASMOS_ARCH_X86_64

config WASMOS_IRQ_PIC
    bool "PIC (legacy 8259 + PIT)"

config WASMOS_IRQ_LAPIC
    bool "LAPIC only (Local APIC + LAPIC timer, 8259 via LINT0 ExtINT)"

config WASMOS_IRQ_IOAPIC
    bool "LAPIC + I/O APIC (full APIC)"

endchoice

config WASMOS_SMP
    bool "Enable Symmetric Multi-Processing (SMP)"
    # The PIC modes keep their mask bytes unlocked and are sound only on one
    # CPU (irq_x86_64.c, g_pic_mask1).
    depends on WASMOS_IRQ_IOAPIC || WASMOS_ARCH_AARCH64
    default n

config WASMOS_SCHED_CALLER_CPU_BIAS
    bool "Enqueue woken threads on the waking CPU's ready queue"
    default y
    help
      When enabled, sched_wake_thread records the calling CPU as the
      receiver's last_cpu before enqueuing, so woken threads land on
      the same CPU as their waker.  This keeps IPC call chains
      cache-local and reduces cross-CPU queue traffic.  Disable to
      revert to scheduler-default placement.

config WASMOS_PM_LIST_ARRAY_CHUNK_CAP
    int "Array-chunk list capacity per chunk"
    default 16
    depends on WASMOS_PM_LIST_ARRAY_CHUNK

choice
    prompt "WASM runtime backend"
    default WASMOS_WASM_RUNTIME_WASM3 if WASMOS_ARCH_AARCH64
    default WASMOS_WASM_RUNTIME_WARP

config WASMOS_WASM_RUNTIME_WASM3
    bool "wasm3 (interpreter)"
    help
      Use the wasm3 tree-walking interpreter. Pure C, minimal footprint.

config WASMOS_WASM_RUNTIME_WARP
    bool "WARP (JIT compiler)"
    help
      Use the WARP single-pass JIT compiler. C++14, near-native execution speed.
      Requires the freestanding C++ ABI shim in the kernel (warp_shim.cpp).

endchoice

config WASMOS_WARP_RUNTIME_LOAD_AOT
    bool "Load bundled AOT binaries at runtime"
    default y if WASMOS_ARCH_X86_64
    help
      When disabled, every WARP app takes the JIT path (initFromBytecode)
      without changing any packed artifact, so an AOT build and a JIT build
      differ only in the kernel. Off by default on aarch64: the bundled AOT
      code is x86_64, and WARP does not check a compiled binary's ISA.

config WASMOS_SCHED_SMP_STRESS
    bool "Run the standalone SMP scheduler stress test"
    default n
    help
      Spawn a cross-CPU token-ring stress and invariant test before the
      scheduler loop starts (kernel_sched_smp_stress_runtime.c).

config QEMU_GDB_PORT
    int "QEMU gdb port for run-qemu-debug"
    default 1234

config WASMOS_SIGNING_KEY
    string "Package signing seed (path to a hex file)"
    default ""
    help
      The Ed25519 seed every .wap this build packs is signed with, as a file
      of 32 bytes in hex. Its public key is compiled into the kernel, which
      grants a manifest's privileged capabilities only to a package signed
      with it (docs/architecture/10-capability-and-policy.md). Empty: the
      build creates a development seed in the build directory
      (signing/dev-seed.hex) once and keeps using it. Packages signed with one
      build's key are refused privilege by a kernel built with another.

endmenu
```

## configs/aarch64_wasm3_smp_defconfig
```kconfig
# wasmos: aarch64 (QEMU virt), wasm3 interpreter, SMP (4 CPUs under QEMU)
CONFIG_WASMOS_ARCH_AARCH64=y
# CONFIG_WASMOS_ARCH_X86_64 is not set
CONFIG_AS_ENABLE=y
CONFIG_RUST_ENABLE=y
CONFIG_GO_ENABLE=y
CONFIG_ZIG_ENABLE=y
CONFIG_WASMOS_TRACE=n
CONFIG_WASMOS_RING3_SMOKE=n
CONFIG_WASMOS_RING3_THREAD_LIFECYCLE_SMOKE=n
CONFIG_WASMOS_PM_TEST_HOOKS=n
CONFIG_WASMOS_PM_LIST_LINKED=y
CONFIG_WASMOS_PM_LIST_ARRAY_CHUNK=n
CONFIG_WASMOS_PM_LIST_ARRAY_CHUNK_CAP=16
CONFIG_QEMU_GDB_PORT=1234
CONFIG_WASMOS_WASM_RUNTIME_WASM3=y
CONFIG_WASMOS_SMP=y
```
