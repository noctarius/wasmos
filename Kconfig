## Kconfig
```kconfig
mainmenu "WASMOS Configuration"

menu "Build Options"

menu "Examples"

config AS_ENABLE
    bool "Enable AssemblyScript example builds"
    default y

config RUST_ENABLE
    bool "Enable Rust example builds"
    default y

config GO_ENABLE
    bool "Enable Go (TinyGo) example builds"
    default y

config ZIG_ENABLE
    bool "Enable Zig example builds"
    default y

endmenu

config WASMOS_TRACE
    bool "Enable verbose kernel and userland tracing"
    default n

config WASMOS_RING3_SMOKE
    bool "Enable ring3 smoke probe spawn by default"
    default n

config WASMOS_RING3_THREAD_LIFECYCLE_SMOKE
    bool "Enable dedicated ring3 thread lifecycle helper probe spawn by default"
    default n

config WASMOS_PM_TEST_HOOKS
    bool "Enable process-manager test inject hooks"
    default n

choice
    prompt "Process-manager list backend"
    default WASMOS_PM_LIST_LINKED

config WASMOS_PM_LIST_LINKED
    bool "Linked list"

config WASMOS_PM_LIST_ARRAY_CHUNK
    bool "Array-chunk list (growable)"

endchoice

choice
    prompt "IRQ controller mode"
    default WASMOS_IRQ_IOAPIC

config WASMOS_IRQ_PIC
    bool "PIC (legacy 8259 + PIT)"

config WASMOS_IRQ_LAPIC
    bool "LAPIC only (Local APIC + LAPIC timer, 8259 via LINT0 ExtINT)"

config WASMOS_IRQ_IOAPIC
    bool "LAPIC + I/O APIC (full APIC)"

endchoice

config WASMOS_SMP
    bool "Enable Symmetric Multi-Processing (SMP)"
    depends on WASMOS_IRQ_IOAPIC
    default n

config WASMOS_PM_LIST_ARRAY_CHUNK_CAP
    int "Array-chunk list capacity per chunk"
    default 16
    depends on WASMOS_PM_LIST_ARRAY_CHUNK

config KERNEL_TARGET_TRIPLE
    string "Kernel target triple"
    default "x86_64-elf"

config QEMU_GDB_PORT
    int "QEMU gdb port for run-qemu-debug"
    default 1234

endmenu
```

## configs/warp_smp_defconfig
```kconfig
# wasmos: WARP JIT (ring 3), SMP
CONFIG_AS_ENABLE=y
CONFIG_RUST_ENABLE=y
CONFIG_GO_ENABLE=y
CONFIG_ZIG_ENABLE=y
CONFIG_WASMOS_TRACE=n
CONFIG_WASMOS_RING3_SMOKE=n
CONFIG_WASMOS_RING3_THREAD_LIFECYCLE_SMOKE=n
CONFIG_WASMOS_PM_TEST_HOOKS=n
CONFIG_WASMOS_PM_LIST_LINKED=y
CONFIG_WASMOS_PM_LIST_ARRAY_CHUNK=n
CONFIG_WASMOS_PM_LIST_ARRAY_CHUNK_CAP=16
CONFIG_WASMOS_IRQ_PIC=n
CONFIG_WASMOS_IRQ_LAPIC=n
CONFIG_WASMOS_IRQ_IOAPIC=y
CONFIG_KERNEL_TARGET_TRIPLE="x86_64-elf"
CONFIG_QEMU_GDB_PORT=1234
# CONFIG_WASMOS_WASM_RUNTIME_WASM3 is not set
CONFIG_WASMOS_WASM_RUNTIME_WARP=y
CONFIG_WASMOS_RING3=y
CONFIG_WASMOS_SMP=y
```

## configs/wasmos_defconfig
```kconfig
CONFIG_AS_ENABLE=y
CONFIG_RUST_ENABLE=y
CONFIG_GO_ENABLE=y
CONFIG_ZIG_ENABLE=y
CONFIG_WASMOS_TRACE=n
CONFIG_WASMOS_RING3_SMOKE=n
CONFIG_WASMOS_RING3_THREAD_LIFECYCLE_SMOKE=n
CONFIG_WASMOS_PM_TEST_HOOKS=n
CONFIG_WASMOS_PM_LIST_LINKED=y
CONFIG_WASMOS_PM_LIST_ARRAY_CHUNK=n
CONFIG_WASMOS_PM_LIST_ARRAY_CHUNK_CAP=16
CONFIG_KERNEL_TARGET_TRIPLE="x86_64-elf"
CONFIG_QEMU_GDB_PORT=1234
```
